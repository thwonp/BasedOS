## buildroot/Config.in
```kconfig
# BasedOS packages of its own.
source "$BR2_EXTERNAL_BASEDOS_PATH/package/flac13/Config.in"
source "$BR2_EXTERNAL_BASEDOS_PATH/package/luajit-lib/Config.in"
source "$BR2_EXTERNAL_BASEDOS_PATH/package/basedos-vkrotate/Config.in"
```

## buildroot/package/basedos-vkrotate/Config.in
```kconfig
config BR2_PACKAGE_BASEDOS_VKROTATE
	bool "basedos-vkrotate"
	depends on BR2_PACKAGE_VULKAN_LOADER
	help
	  VK_LAYER_BASEDOS_rotate, an implicit Vulkan layer: apps that
	  draw straight to the display through VK_KHR_display (RetroArch's
	  Vulkan driver) see the 350H Ultra's 1440x1600 portrait panel as
	  1600x1440 landscape, and the layer turns each frame onto the
	  panel when it is presented. The Vulkan counterpart of BasedOS's
	  SDL2 rotation patch (tools/sdl2). BasedOS's own source, in src/.
```

## buildroot/package/luajit-lib/Config.in
```kconfig
config BR2_PACKAGE_LUAJIT_LIB
	bool "luajit-lib"
	depends on BR2_aarch64
	help
	  LuaJIT's shared library only (libluajit-5.1.so.2), which
	  PortMaster's ports load, beside Lua 5.4 for WirePlumber.
	  Buildroot's luajit excludes lua (both provide luainterpreter).
```
